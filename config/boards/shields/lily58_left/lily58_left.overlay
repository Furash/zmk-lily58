/ {
    chosen {
        zmk,display = &nice_view;
    };
};

&spi1 {
    compatible = "nordic,nrf-spi";
    status = "okay";
    cs-gpios = <&gpio0 6 GPIO_ACTIVE_LOW>; /* P0.06 for CS */
    pinctrl-0 = <&spi1_default>;
    pinctrl-1 = <&spi1_sleep>;
    pinctrl-names = "default", "sleep";
    nice_view: nice_view@0 {
        compatible = "ssd1306fb";
        reg = <0>;
        spi-max-frequency = <8000000>;
        reset-gpios = <&gpio0 7 GPIO_ACTIVE_LOW>; /* P0.07 for reset, adjust if needed */
        width = <128>;
        height = <32>;
        display-type = "nice_view";
    };
};