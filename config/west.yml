## config/west.yml
```yaml
manifest:
  remotes:
    - name: zmkfirmware
      url-base: https://github.com/zmkfirmware
    - name: Furash 
      url-base: https://github.com/Furash
  projects:
    - name: zmk
      remote: zmkfirmware
      revision: v0.2
      import: app/west.yml
    - name: nice-view-gem
      remote: Furash 
      revision: pinned_zmk
  self:
    path: config
```
